AUTOSAR XML (schema 00051)
package /S01UCON/Comm
  pdu bridgeToSteerIPdu: length=8  # Authentic/plain I-PDU bridgeToSteerIPdu
    signal bridgeToSteerISig: start 0, 64 bit, little-endian, system signal bridgeToSteerSSig
  pdu huToBridgeIPdu: length=8  # Authentic/plain I-PDU huToBridgeIPdu
    signal huToBridgeISig: start 0, 64 bit, little-endian, system signal huToBridgeSSig
