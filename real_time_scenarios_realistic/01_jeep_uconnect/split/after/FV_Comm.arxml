AUTOSAR XML (schema 00051)
package /FV/Comm
  pdu BodyIPdu: length=8  # Authentic/plain I-PDU BodyIPdu
    signal BodyISig: start 0, 64 bit, little-endian, system signal BodySSig
  pdu ComfortIPdu: length=8  # Authentic/plain I-PDU ComfortIPdu
    signal ComfortISig: start 0, 64 bit, little-endian, system signal ComfortSSig
  pdu DecelIPdu: length=8  # Authentic/plain I-PDU DecelIPdu
    signal DecelISig: start 0, 64 bit, little-endian, system signal DecelSSig
  secured i pdu DecelSecuredIPdu: length=13, payload=Trg_DecelIPdu, secure-communication-props={auth-algorithm=CMAC, auth-info-tx-length=32, data-id=259, freshness-value-id=4, freshness-value-length=8, freshness-value-tx-length=8}, use-as-cryptographic-i-pdu=false  # SecOC secured I-PDU DecelSecuredIPdu
  pdu EngineIPdu: length=8  # Authentic/plain I-PDU EngineIPdu
    signal EngineISig: start 0, 64 bit, little-endian, system signal EngineSSig
  secured i pdu EngineSecuredIPdu: length=13, payload=Trg_EngineIPdu, secure-communication-props={auth-algorithm=CMAC, auth-info-tx-length=32, data-id=260, freshness-value-id=5, freshness-value-length=8, freshness-value-tx-length=8}, use-as-cryptographic-i-pdu=false  # SecOC secured I-PDU EngineSecuredIPdu
  pdu LightIPdu: length=8  # Authentic/plain I-PDU LightIPdu
    signal LightISig: start 0, 64 bit, little-endian, system signal LightSSig
  pdu NavIPdu: length=8  # Authentic/plain I-PDU NavIPdu
    signal NavISig: start 0, 64 bit, little-endian, system signal NavSSig
  secured i pdu NavSecuredIPdu: length=13, payload=Trg_NavIPdu, secure-communication-props={auth-algorithm=CMAC, auth-info-tx-length=32, data-id=256, freshness-value-id=1, freshness-value-length=8, freshness-value-tx-length=8}, use-as-cryptographic-i-pdu=false  # SecOC secured I-PDU NavSecuredIPdu
  pdu OtaIPdu: length=8  # Authentic/plain I-PDU OtaIPdu
    signal OtaISig: start 0, 64 bit, little-endian, system signal OtaSSig
  pdu TcuGwIPdu: length=8  # Authentic/plain I-PDU TcuGwIPdu
    signal TcuGwISig: start 0, 64 bit, little-endian, system signal TcuGwSSig
  secured i pdu TcuGwSecuredIPdu: length=13, payload=Trg_TcuGwIPdu, secure-communication-props={auth-algorithm=CMAC, auth-info-tx-length=32, data-id=257, freshness-value-id=2, freshness-value-length=8, freshness-value-tx-length=8}, use-as-cryptographic-i-pdu=false  # SecOC secured I-PDU TcuGwSecuredIPdu
  pdu V2xIPdu: length=8  # Authentic/plain I-PDU V2xIPdu
    signal V2xISig: start 0, 64 bit, little-endian, system signal V2xSSig
  secured i pdu V2xSecuredIPdu: length=13, payload=Trg_V2xIPdu, secure-communication-props={auth-algorithm=CMAC, auth-info-tx-length=32, data-id=258, freshness-value-id=3, freshness-value-length=8, freshness-value-tx-length=8}, use-as-cryptographic-i-pdu=false  # SecOC secured I-PDU V2xSecuredIPdu
