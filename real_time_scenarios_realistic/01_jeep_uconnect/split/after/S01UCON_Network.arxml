AUTOSAR XML (schema 00051)
package /S01UCON/Network
  can cluster Backbone: baudrate=500000, can-fd-baudrate=2000000
    can physical channel Ch0: comm-connectors=[CanConn0, CanConn0, CanConn0]
      frame Frame_bridgeToSteerIPdu: id 0x400, frame-length=8, can-addressing-mode=STANDARD, can-frame-rx-behavior=CAN-FD, can-frame-tx-behavior=CAN-FD
        carries pdu bridgeToSteerIPdu: packing-byte-order=little-endian, start-position=0
      frame Frame_huToBridgeIPdu: id 0x401, frame-length=8, can-addressing-mode=STANDARD, can-frame-rx-behavior=CAN-FD, can-frame-tx-behavior=CAN-FD
        carries pdu huToBridgeIPdu: packing-byte-order=little-endian, start-position=0
      pdu triggering Trg_bridgeToSteerIPdu: pdu=bridgeToSteerIPdu
      pdu triggering Trg_huToBridgeIPdu: pdu=huToBridgeIPdu
