AUTOSAR XML (schema 00051)
package /FV/Network
  can cluster Backbone: baudrate=500000, can-fd-baudrate=2000000
    can physical channel Ch0: comm-connectors=[CanConn0, CanConn0, CanConn0, CanConn0, CanConn0, CanConn0, CanConn0, CanConn0]
      frame Frame_BodyIPdu: id 0x100, frame-length=8, can-addressing-mode=STANDARD, can-frame-rx-behavior=CAN-FD, can-frame-tx-behavior=CAN-FD
        carries pdu BodyIPdu: packing-byte-order=little-endian, start-position=0
      frame Frame_ComfortIPdu: id 0x101, frame-length=8, can-addressing-mode=STANDARD, can-frame-rx-behavior=CAN-FD, can-frame-tx-behavior=CAN-FD
        carries pdu ComfortIPdu: packing-byte-order=little-endian, start-position=0
      frame Frame_DecelSecuredIPdu: id 0x102, frame-length=16, can-addressing-mode=STANDARD, can-frame-rx-behavior=CAN-FD, can-frame-tx-behavior=CAN-FD
        carries pdu DecelSecuredIPdu: packing-byte-order=little-endian, start-position=0
      frame Frame_EngineSecuredIPdu: id 0x103, frame-length=16, can-addressing-mode=STANDARD, can-frame-rx-behavior=CAN-FD, can-frame-tx-behavior=CAN-FD
        carries pdu EngineSecuredIPdu: packing-byte-order=little-endian, start-position=0
      frame Frame_LightIPdu: id 0x104, frame-length=8, can-addressing-mode=STANDARD, can-frame-rx-behavior=CAN-FD, can-frame-tx-behavior=CAN-FD
        carries pdu LightIPdu: packing-byte-order=little-endian, start-position=0
      frame Frame_NavSecuredIPdu: id 0x105, frame-length=16, can-addressing-mode=STANDARD, can-frame-rx-behavior=CAN-FD, can-frame-tx-behavior=CAN-FD
        carries pdu NavSecuredIPdu: packing-byte-order=little-endian, start-position=0
      frame Frame_OtaIPdu: id 0x106, frame-length=8, can-addressing-mode=STANDARD, can-frame-rx-behavior=CAN-FD, can-frame-tx-behavior=CAN-FD
        carries pdu OtaIPdu: packing-byte-order=little-endian, start-position=0
      frame Frame_TcuGwSecuredIPdu: id 0x107, frame-length=16, can-addressing-mode=STANDARD, can-frame-rx-behavior=CAN-FD, can-frame-tx-behavior=CAN-FD
        carries pdu TcuGwSecuredIPdu: packing-byte-order=little-endian, start-position=0
      frame Frame_V2xSecuredIPdu: id 0x108, frame-length=16, can-addressing-mode=STANDARD, can-frame-rx-behavior=CAN-FD, can-frame-tx-behavior=CAN-FD
        carries pdu V2xSecuredIPdu: packing-byte-order=little-endian, start-position=0
      pdu triggering Trg_BodyIPdu: pdu=BodyIPdu
      pdu triggering Trg_ComfortIPdu: pdu=ComfortIPdu
      pdu triggering Trg_DecelIPdu: pdu=DecelIPdu
      pdu triggering Trg_DecelSecuredIPdu: pdu=DecelSecuredIPdu
      pdu triggering Trg_EngineIPdu: pdu=EngineIPdu
      pdu triggering Trg_EngineSecuredIPdu: pdu=EngineSecuredIPdu
      pdu triggering Trg_LightIPdu: pdu=LightIPdu
      pdu triggering Trg_NavIPdu: pdu=NavIPdu
      pdu triggering Trg_NavSecuredIPdu: pdu=NavSecuredIPdu
      pdu triggering Trg_OtaIPdu: pdu=OtaIPdu
      pdu triggering Trg_TcuGwIPdu: pdu=TcuGwIPdu
      pdu triggering Trg_TcuGwSecuredIPdu: pdu=TcuGwSecuredIPdu
      pdu triggering Trg_V2xIPdu: pdu=V2xIPdu
      pdu triggering Trg_V2xSecuredIPdu: pdu=V2xSecuredIPdu
