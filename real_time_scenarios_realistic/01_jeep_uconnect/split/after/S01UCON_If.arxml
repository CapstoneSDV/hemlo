AUTOSAR XML (schema 00051)
package /S01UCON/If
  sender receiver interface CanFrame  # Sender/receiver interface CanFrame
    data val: type=Byte8Array
  sender receiver interface CellLink  # Sender/receiver interface CellLink
    data val: type=Byte8Array
  sender receiver interface DbusCmd  # Sender/receiver interface DbusCmd
    data val: type=Byte8Array
