AUTOSAR XML (schema 00051)
package /FV/If
  23 x sender receiver interface:
    AmbientCmd  # Sender/receiver interface AmbientCmd
      data color: type=Byte8Array
    BodyCmd  # Sender/receiver interface BodyCmd
      data cmd: type=Byte8Array
    BrakeForce  # Sender/receiver interface BrakeForce
      data force: type=Byte8Array
    ComfortMode  # Sender/receiver interface ComfortMode
      data mode: type=Byte8Array
    DecelReq  # Sender/receiver interface DecelReq
      data decel: type=Byte8Array
    DiagCmd  # Sender/receiver interface DiagCmd
      data cmd: type=Byte8Array
    DoorCmd  # Sender/receiver interface DoorCmd
      data lock: type=Byte8Array
    EmisData  # Sender/receiver interface EmisData
      data emis: type=Byte8Array
    EngineCmd  # Sender/receiver interface EngineCmd
      data torque: type=Byte8Array
    FwPolicy  # Sender/receiver interface FwPolicy
      data rule: type=Byte8Array
    HvacCmd  # Sender/receiver interface HvacCmd
      data temp: type=Byte8Array
    LaneData  # Sender/receiver interface LaneData
      data lanes: type=Byte8Array
    LightCmd  # Sender/receiver interface LightCmd
      data level: type=Byte8Array
    MediaReq  # Sender/receiver interface MediaReq
      data payload: type=Byte8Array
    MediaStream  # Sender/receiver interface MediaStream
      data stream: type=Byte8Array
    NavRoute  # Sender/receiver interface NavRoute
      data route: type=Byte8Array
    ObjData  # Sender/receiver interface ObjData
      data objects: type=Byte8Array
    OtaCmd  # Sender/receiver interface OtaCmd
      data pkg: type=Byte8Array
    RemoteSvc  # Sender/receiver interface RemoteSvc
      data val: type=Byte8Array
    SteerAngle  # Sender/receiver interface SteerAngle
      data angle: type=Byte8Array
    TailCmd  # Sender/receiver interface TailCmd
      data level: type=Byte8Array
    TransGear  # Sender/receiver interface TransGear
      data gear: type=Byte8Array
    V2xMsg  # Sender/receiver interface V2xMsg
      data msg: type=Byte8Array
