AUTOSAR XML (schema 00051)
package /S01UCON/Topology
  ecu instance ChassisEcu: sleep-mode-supported=false, wake-up-over-bus-supported=false  # ECU instance ChassisEcu
    can communication controller CanCtrl0: wake-up-by-controller-supported=false
    can communication connector CanConn0: comm-controller=ChassisEcu/CanCtrl0
  ecu instance GatewayEcu: sleep-mode-supported=false, wake-up-over-bus-supported=false  # ECU instance GatewayEcu
    can communication controller CanCtrl0: wake-up-by-controller-supported=false
    can communication connector CanConn0: comm-controller=GatewayEcu/CanCtrl0
  ecu instance TelematicsEcu: sleep-mode-supported=false, wake-up-over-bus-supported=false  # ECU instance TelematicsEcu
    can communication controller CanCtrl0: wake-up-by-controller-supported=false
    can communication connector CanConn0: comm-controller=TelematicsEcu/CanCtrl0
  system Veh: category=SYSTEM_EXTRACT  # System extract Veh
    system mapping Map
      data-mappings:
        data-element=Root.huToBridgeOut.val, system-signal=huToBridgeSSig
        data-element=Root.bridgeToSteerOut.val, system-signal=bridgeToSteerSSig
      sw-mappings:
        swc to ecu mapping ToChassisEcu: component=steer, ecu-instance=ChassisEcu
        swc to ecu mapping ToGatewayEcu: component=bridge, ecu-instance=GatewayEcu
        swc to ecu mapping ToTelematicsEcu: component=[ivi, tel], ecu-instance=TelematicsEcu
    root-software-compositions:
      root sw composition prototype Root: software-composition=Root
