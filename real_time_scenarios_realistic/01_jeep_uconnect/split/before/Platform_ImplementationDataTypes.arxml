AUTOSAR XML (schema 00051)
standard types defined: Boolean, UInt16, UInt32, UInt8
package /Platform/ImplementationDataTypes
  impl type Byte8Array: category=ARRAY
    element Element: array-size=8, array-size-semantics=FIXED-SIZE, implementation-data-type=UInt8
