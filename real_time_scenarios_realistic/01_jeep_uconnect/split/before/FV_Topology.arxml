AUTOSAR XML (schema 00051)
package /FV/Topology
  ecu instance AdasEcu: sleep-mode-supported=false, wake-up-over-bus-supported=false  # ECU instance AdasEcu
    can communication controller CanCtrl0: wake-up-by-controller-supported=false
    can communication connector CanConn0: comm-controller=AdasEcu/CanCtrl0
  ecu instance BodyEcu: sleep-mode-supported=false, wake-up-over-bus-supported=false  # ECU instance BodyEcu
    can communication controller CanCtrl0: wake-up-by-controller-supported=false
    can communication connector CanConn0: comm-controller=BodyEcu/CanCtrl0
  ecu instance ChassisEcu: sleep-mode-supported=false, wake-up-over-bus-supported=false  # ECU instance ChassisEcu
    can communication controller CanCtrl0: wake-up-by-controller-supported=false
    can communication connector CanConn0: comm-controller=ChassisEcu/CanCtrl0
  system FullVeh: category=SYSTEM_EXTRACT  # System extract FullVeh
    system mapping Map
      data-mappings:
        data-element=Root.DecelOut.decel, system-signal=DecelSSig
        data-element=Root.BodyOut.cmd, system-signal=BodySSig
        data-element=Root.ComfortOut.mode, system-signal=ComfortSSig
        data-element=Root.EngineOut.torque, system-signal=EngineSSig
        data-element=Root.LightOut.level, system-signal=LightSSig
        data-element=Root.NavOut.route, system-signal=NavSSig
        data-element=Root.OtaOut.pkg, system-signal=OtaSSig
        data-element=Root.RemoteOut.val, system-signal=TcuGwSSig
        data-element=Root.V2xOut.msg, system-signal=V2xSSig
      sw-mappings:
        8 x swc to ecu mapping:
          ToAdas: component=[adas, laneKeep, objDetect], ecu-instance=AdasEcu
          ToBody: component=[bcm, doorLock, hvacCtl], ecu-instance=BodyEcu
          ToChassis: component=[brakeAct, brakeCtl, steerCtl], ecu-instance=ChassisEcu
          ToGateway: component=[cgw, diagRouter, firewallMgr], ecu-instance=GatewayEcu
          ToIvi: component=[btStack, ivi, mediaPlayer], ecu-instance=IviEcu
          ToLight: component=[ambientLight, headlight, taillight], ecu-instance=LightEcu
          ToPt: component=[emisCtl, engineCtl, transCtl], ecu-instance=PtEcu
          ToTelematics: component=[otaManager, tcu, v2xStack], ecu-instance=TelematicsEcu
    root-software-compositions:
      root sw composition prototype Root: software-composition=FullVehicle
  5 x ecu instance, all with sleep-mode-supported=false, wake-up-over-bus-supported=false:
    GatewayEcu  # ECU instance GatewayEcu
      can communication controller CanCtrl0: wake-up-by-controller-supported=false
      can communication connector CanConn0: comm-controller=GatewayEcu/CanCtrl0
    IviEcu  # ECU instance IviEcu
      can communication controller CanCtrl0: wake-up-by-controller-supported=false
      can communication connector CanConn0: comm-controller=IviEcu/CanCtrl0
    LightEcu  # ECU instance LightEcu
      can communication controller CanCtrl0: wake-up-by-controller-supported=false
      can communication connector CanConn0: comm-controller=LightEcu/CanCtrl0
    PtEcu  # ECU instance PtEcu
      can communication controller CanCtrl0: wake-up-by-controller-supported=false
      can communication connector CanConn0: comm-controller=PtEcu/CanCtrl0
    TelematicsEcu  # ECU instance TelematicsEcu
      can communication controller CanCtrl0: wake-up-by-controller-supported=false
      can communication connector CanConn0: comm-controller=TelematicsEcu/CanCtrl0
