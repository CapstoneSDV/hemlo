AUTOSAR XML (schema 00051)
package /S01UCON/Network
  can cluster Backbone: baudrate=500000, can-fd-baudrate=2000000
    can physical channel Ch0: comm-connectors=[CanConn0, CanConn0, CanConn0]
