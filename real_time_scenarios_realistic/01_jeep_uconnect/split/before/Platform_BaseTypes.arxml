AUTOSAR XML (schema 00051)
standard types defined: boolean, uint16, uint32, uint8
