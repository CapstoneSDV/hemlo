AUTOSAR XML (schema 00051)
package /S01UCON/If
  sender receiver interface CellLink  # Sender/receiver interface CellLink
    data val: type=Byte8Array
